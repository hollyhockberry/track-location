// beacon/beaconpreferences.cpp
//
// Copyright (c) 2021 Inaba
// This software is released under the MIT License.
// http://opensource.org/licenses/mit-license.php

#include "beaconpreferences.h"
#include <Preferences.h>

// default UUID generated by uuidgen
BeaconPreferences::BeaconPreferences()
: _uuid("7626EE90-9058-4BA7-B28B-A4E3B1C81583"),
  _major(), _minor(), _advertising_sec(10), _sleeptime_sec(10) {
}

bool BeaconPreferences::Load() {
  Preferences preferences;
  preferences.begin("iBeacon", true);
  if (!preferences.isKey("uuid") ||
      !preferences.isKey("major") || !preferences.isKey("minor") ||
      !preferences.isKey("advsec") || !preferences.isKey("sleepsec")) {
    preferences.end();
    return false;
  }
  _major = preferences.getUShort("major");
  _minor = preferences.getUShort("minor");
  _advertising_sec = preferences.getULong("advsec");
  _sleeptime_sec = preferences.getULong64("sleepsec");
  preferences.end();
  return true;
}

namespace {

void readLine(String* line, bool echo = true) {
  while (true) {
    while (Serial.available() == 0) {}
    int c = Serial.read();
    if (c == 0xd || c == 0xa) {
      if (echo) Serial.println();
      break;
    }
    if (echo) Serial.printf("%c", c);
    *line += static_cast<char>(c);
  }
}

bool isHexadecimal(const String& str, int begin, int end) {
  if (str.length() != 36)
    return false;
  for (int x = begin; x <= end; ++x) {
    if (!::isxdigit(str[x])) return false;
  }
  return true;
}

bool checkUUID(const String& uuid) {
  if (uuid[8] != '-' || uuid[13] != '-' ||
      uuid[18] != '-' || uuid[23] != '-') {
    return false;
  }
  if (!isHexadecimal(uuid, 0, 7))
    return false;
  if (!isHexadecimal(uuid, 9, 12))
    return false;
  if (!isHexadecimal(uuid, 14, 17))
    return false;
  if (!isHexadecimal(uuid, 19, 22))
    return false;
  if (!isHexadecimal(uuid, 24, 35))
    return false;

  return true;
}

bool readUUID(String* uuid) {
  Serial.print("UUID: ");
  String line;
  readLine(&line);
  if (line != "") {
    if (!checkUUID(line)) {
      return false;
    }
    *uuid = line;
  }
  return true;
}

bool read(const char* key, int* value) {
  Serial.printf("%s: ", key);
  String line;
  readLine(&line);
  if (line == "") {
    return false;
  }
  *value = static_cast<int>(line.toInt()) & 0xffff;
  return true;
}

template <typename T>
void readValue(const char* key, T* value) {
  int v;
  if (read(key, &v)) {
    *value = static_cast<T>(v);
  }
}

}  // namespace

void BeaconPreferences::Run() {
  Serial.println();
  Serial.println("Welcome to setup mode !");
  Show();
  Serial.println();

  while (!readUUID(&_uuid)) {
    Serial.println(" format error!");
  }
  readValue<uint16_t>("Major", &_major);
  readValue<uint16_t>("Minor", &_minor);
  readValue<uint32_t>("Advertising", &_advertising_sec);
  readValue<uint64_t>("Sleep", &_sleeptime_sec);
  Serial.println();
  Show();

  Serial.print("Apply OK? [Y/n] ");
  String line;
  readLine(&line);
  line.toLowerCase();

  if (line == "" || line == "y") {
    Serial.println("Saving parameters...");
    Preferences preferences;
    preferences.begin("iBeacon");
    preferences.putString("uuid", _uuid);
    preferences.putUShort("major", _major);
    preferences.putUShort("minor", _minor);
    preferences.putULong("advsec", _advertising_sec);
    preferences.putULong64("sleepsec", _sleeptime_sec);
    preferences.end();
  }

  Serial.println("reboot after a few seconds.");
  ::delay(3000);
  ESP.restart();
  for (;;) {}
  // never reach
}

void BeaconPreferences::Show() const {
  Serial.printf("UUID: %s\r\n", _uuid.c_str());
  Serial.printf("Major: %04d(0x%04X)\r\n", _major, _major);
  Serial.printf("Minor: %04d(0x%04X)\r\n", _minor, _minor);
  Serial.printf("Advertising: %u seconds  ", _advertising_sec);
  Serial.printf("Sleep: %llu seconds\r\n", _sleeptime_sec);
}
